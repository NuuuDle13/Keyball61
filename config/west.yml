## config/west.yml
```yaml
manifest:
  remotes:
    - name: teamspatzenhirn
      url-base: https://github.com/teamspatzenhirn
  projects:
    - name: pmw3389_zephyr_driver
      remote: teamspatzenhirn
      revision: 837e0ab
      path: modules/pmw3389
self:
  path: config
```
